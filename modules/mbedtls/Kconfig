## modules/mbedtls/Kconfig
```kconfig
#
# Copyright (c) 2021 Nordic Semiconductor ASA
#
# SPDX-License-Identifier: LicenseRef-Nordic-5-Clause
#

config MBEDTLS_HEAP_SIZE
	default 8320 if BUILD_WITH_TFM
	help
	  Increase the heap size of mbedtls when building with TF-M.
```
